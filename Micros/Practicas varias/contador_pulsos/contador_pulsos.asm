;CONTADOR DE PULSOS


.INCLUDE	"M8535DEF.INC"
 
.EQU    GUION 	= 	$40
.EQU 	_CERO 	=	$3F
.EQU 	_UNO 	=	$06
.EQU 	_DOS		=	$5B
.EQU 	_TRES 	=	$4F
.EQU 	_CUATRO 	=	$66
.EQU 	_CINCO 	=	$6D
.EQU 	_SEIS	=	$7D
.EQU 	_SIETE 	=	$07
.EQU 	_OCHO 	=	$7F
.EQU 	_NUEVE 	=	$67

;EQU de 0-9 PONER VALORES
.CSEG		
.ORG	$0					
      	RJMP	INICIO				
.ORG	$015				
INICIO:
      	LDI		R16,	LOW(RAMEND)	
     	OUT		SPL,	R16			
     	LDI		R16,	HIGH(RAMEND)
      	OUT		SPL,	R16		 
		SER		R16							;PONE AL REGISTRO R16 EN $FF TODOS SUS BITS
		OUT		DDRC,	R16					;CONFIGURA R16 CONO SALIDA	
		OUT		PORTB,	R16					;PASA LOS VALORES DE R16 AL PUERTO B
		LDI		R17,	GUION				;LE PASA EL VALOR DE "GUION" A R17
		OUT		PORTC,	R17					;SACA VALOR QUE SE PASA A PUERTO C
      		
LOOP:
		SBIC	PINB,	0
		RJMP	LOOP
	;	RCALL	CONTEO	
		RCALL	DELAY
		RJMP	LOOP
				
DELAY:
     	DEC		R20					
    	BRNE	DELAY
    	DEC		R21					
     	BRNE	DELAY				
      	RET	
		
;CONTEO:
		CPI		R18,	$00
		BREQ	_CERO

		
