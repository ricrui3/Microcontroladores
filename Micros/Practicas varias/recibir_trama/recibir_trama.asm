;;;;;;;;;;;;;;;;;;;;;;;;;;;;;;;;;;;;;;;;;;;;;;;;;;;;;;;;;;;;;;;;;;;;;;;;;;;;;
;;;;;;;;;;;;;PROGRAMA PARA LA RECEPCIÓN DE UNA TRAMA;;;;;;;;;;;;;;;;;;;;;;
;;;;;;;;;;;;;;;;;;;;;;;;;;;;;;;;;;;;;;;;;;;;;;;;;;;;;;;;;;;;;;;;;;;;;;;;;;;;;

	.include "m8535def.inc"
	.cseg		;QUE TODO LO QUE SIGUE VA A LA MEMORIA DE CÓDIGO
	.org $0		;DESDE DIRECCIÓN CERO EMPIEZA
	rjmp INICIO



INICIO: 
	LDI 	R16, 	LOW(RAMEND)		;;;
	OUT 	SPL, 	R16				;;;SE INICIALIZA EL START POINT
	LDI 	R16, 	HIGH(RAMEND)	;;;
	OUT 	SPH, 	R16				;;;

	LDI		R16,	77				;;;SE CONFIGURA LA FRECUENCIA 9600@12MHz	
	OUT 	UBRRL, 	R16				;;;

	SBI		UCSRB,	RXEN			;;;SE ENCIENDE EN MODO DE RECEPCIÓN
				
	LDI		R16,	$FF				;;;VALOR DE FF PARA MANDAR COMO SALIDA TODO EL PURTO
	OUT		DDRB,	R16				;;;PUERTO B COMO SALIDA								
DATO:
	SBIS	UCSRA,	RXC				;;;SE ESPERA DATO RECIBIDO 'SBIS' PARA SALTAR LINEA SI ES VERDADERO
	RJMP	DATO
	IN		R16,	UDR				;;;LEE DATO RECIBIDO
	CPI		R16,	$45
	BRNE	DATO
	RJMP	DATO_2
DATO_2:	

	SBIS	UCSRA,	RXC				;;;SE ESPERA DATO RECIBIDO 'SBIS' PARA SALTAR LINEA SI ES VERDADERO
	RJMP	DATO_2
	IN		R16,	UDR				;;;LEE DATO RECIBIDO
	CPI		R16,	$53
	BRNE	DATO_2
	LDI		R16,	$00
	RJMP	ACCION

ACCION:
	SBIS	UCSRA,	RXC				;;;SE ESPERA DATO RECIBIDO 'SBIS' PARA SALTAR LINEA SI ES VERDADERO
	RJMP	ACCION
	IN		R16,	UDR
	OUT		PORTB,	R16				;;;ESCIRBE DATO EN PUERTO B
	RJMP	DATO
	


