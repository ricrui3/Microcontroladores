;;;;;;;MOTOR A PASOS CONTROLADO POR COMUNICACIÓN SERIAL;;;;;;;;;;;;;;

	.include "m8535def.inc"
	.cseg
	.org $0
	rjmp INICIO
	.org	$15

INICIO: 
	LDI R16, LOW(RAMEND)
	OUT SPL, R16
	LDI R16, HIGH(RAMEND)
	OUT SPH, R16


;;;;;;;;;;; SE CONFIGURA EL MODO TRANSMICIÓN PARA COMUNICACIÓN SERIAL;;;;;;;;;;;;;;;;;;;;	
	LDI		R16,	77				;;;SE CONFIGURA LA FRECUENCIA 9600@12MHz	
	OUT 	UBRRL, 	R16				;;;
	SBI		UCSRB,	RXEN			;;;SE ENCIENDE EN MODO DE RECEPCIÓN

;;;;;;;;;;; PUERTO B SE CONFIGURA COMO SALIDA ;;;;;;;;;;;;;;;;;;;;;;;;;;;;;;;;;;;;;;;;;
	SER 	R16					;SE PONE EN 1 TODOS LOS BITS DE R16
	OUT 	DDRB, R16			;SE PONE COMO SALIDA PORTB
;;;;;;;;;;;	PUERTO A SE CONFIGURA COMO ENTRADA;;;;;;;;;;;;;;;;;;
	LDI		R16,	$FF
	OUT 	PORTA,	R16
;;;;;;;;;;;;;;;;;;;;;;;;;;;;;;;;;;;;;;;;;;;;;;;;;;;;
LOOP:
	
	LDI		R16,	$00
	OUT		PORTB,	R16

TRANS:
	RCALL	DATO	
	CPI		R16,	$44				;;CPI CHECA SI ES IGUAL A $44 = D
	BRNE	TRANS_2					;;SI NO ES IGUAL REGRESA A TRANS
	RJMP	DERECHA


TRANS_2:
	CPI		R16,	$49				;;CHECA SI ES IGUAL A I
	BRNE	TRANS
	RJMP	IZQUIERDA


DERECHA:
	LDI		R16,	$00
	OUT		PORTB,	R16
	RCALL	DELAY

	LDI		R16,	$01
	OUT		PORTB,	R16
	RCALL	DELAY

	LDI		R16,	$02
	OUT		PORTB,	R16
	RCALL	DELAY

	LDI		R16,	$04
	OUT		PORTB,	R16
	RCALL	DELAY

	LDI		R16,	$08
	OUT		PORTB,	R16
	RCALL	DELAY

	LDI		R16,	$00
	OUT		PORTB,	R16
	
	RJMP TRANS


IZQUIERDA:
	LDI		R16,	$08
	OUT		PORTB,	R16
	RCALL	DELAY

	LDI		R16,	$04
	OUT		PORTB,	R16
	RCALL	DELAY

	LDI		R16,	$02
	OUT		PORTB,	R16
	RCALL	DELAY

	LDI		R16,	$01
	OUT		PORTB,	R16
	RCALL	DELAY

	LDI		R16,	$00
	OUT		PORTB,	R16
	
	RJMP TRANS

;;;;;;;;;;; SE ESPERA RECEPCIÓN DE DATO ;;;;;;;;;;;;;;;;;;;;;;;;;;;;;;
DATO:
	SBIS	UCSRA,	RXC				;;;SE ESPERA DATO RECIBIDO 'SBIS' PARA SALTAR LINEA SI ES VERDADERO
	RJMP	DATO
	IN		R16,	UDR				;;;LEE DATO RECIBIDO
	RET

;;;;;;;;;;;;; RUTINA DE RETARDO ;;;;;;;;;;;;;;;;;;;;;

DELAY:
	IN		R22,	PINA

DLY:
    DEC		R20					
    BRNE	DLY
   	DEC		R21					
    BRNE	DLY
	DEC		R22
	BRNE	DLY				
    RET	



