
	.include "m8535def.inc"
	.cseg		;QUE TODO LO QUE SIGUE VA A LA MEMORIA DE CсDIGO
	.org $0		;DESDE DIRECCIсN CERO EMPIEZA
	rjmp INICIO
	.org $15


INICIO: 
	LDI 	R16, 	LOW(RAMEND)		;;;
	OUT 	SPL, 	R16				;;;SE INICIALIZA EL START POINT
	LDI 	R16, 	HIGH(RAMEND)	;;;
	OUT 	SPH, 	R16				;;;



	SER		R16				
	OUT		DDRB,	R16		;CONFIGURA PUERTO B Y C COMO SALIDA
	OUT		DDRC,	R16		;;;;;;;;;;;;;;;;;;;;;;;;;;;;;
	LDI		R16,	$00		
	OUT		ADMUX,	R16		;;;;;;;;;;;;;;;;
	LDI		R16,	$A5
	OUT		ADCSRA,	R16
	SBI		ADCSRA,	6

LOOP:
	SBIS	ADCSRA,	4
	RJMP	LOOP
	IN 		R17,	ADCL
	IN		R18,	ADCH
	OUT		PORTB,	R17
	OUT		PORTC,	R18
	RJMP	LOOP

DATO:
	SBIS	UCSRA,	RXC				;;;SE ESPERA DATO RECIBIDO
	RJMP	DATO
	IN		R16,	UDR				;;;LEE DATO RECIBIDO
	OUT		PORTB,	R16				;;;ESCIRBE DATO EN PUERTO B
	OUT		OCR2,	R16
	RJMP	DATO



