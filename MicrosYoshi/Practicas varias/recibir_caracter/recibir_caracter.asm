;;;;;;;;;;;;;;;;;;;;;;;;;;;;;;;;;;;;;;;;;;;;;;;;;;;;;;;;;;;;;;;;;;;;;;;;;;;;;
;;;;;;;;;;;;;PROGRAMA PARA LA RECEPCIÓN DE UN CARACTER;;;;;;;;;;;;;;;;;;;;;;
;;;;;;;;;;;;;;;;;;;;;;;;;;;;;;;;;;;;;;;;;;;;;;;;;;;;;;;;;;;;;;;;;;;;;;;;;;;;;

	.include "m8535def.inc"
	.cseg		;QUE TODO LO QUE SIGUE VA A LA MEMORIA DE CÓDIGO
	.org $0		;DESDE DIRECCIÓN CERO EMPIEZA
	rjmp INICIO



INICIO: 
	LDI 	R16, 	LOW(RAMEND)		;;;
	OUT 	SPL, 	R16				;;;SE INICIALIZA EL START POINT
	LDI 	R16, 	HIGH(RAMEND)	;;;
	OUT 	SPH, 	R16				;;;

	LDI		R16,	77				;;;SE CONFIGURA LA FRECUENCIA 9600@12MHz	
	OUT 	UBRRL, 	R16				;;;

	SBI		UCSRB,	RXEN			;;;SE ENCIENDE EN MODO DE RECEPCIÓN
				
	LDI		R16,	$FF				;;;VALOR DE FF PARA MANDAR COMO SALIDA TODO EL PURTO
	OUT		DDRB,	R16				;;;PUERTO B COMO SALIDA								
DATO:
	SBIS	UCSRA,	RXC				;;;SE ESPERA DATO RECIBIDO
	RJMP	DATO
	IN		R16,	UDR				;;;LEE DATO RECIBIDO
	OUT		PORTB,	R16				;;;ESCIRBE DATO EN PUERTO B
	RJMP	DATO_1


DATO_1:

	OUT		UDR,	R16				;;;SE TRANSMITE CARACTER 'A'

LOOP:
	
	SBIS	UCSRA,	UDRE			;;SE ESPERA EL FIN DE TRANSMICIÓN DEL CARACTER
	RJMP	LOOP
