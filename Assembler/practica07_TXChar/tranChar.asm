; Author : Ricardo Ruiz Maldonado
; Practica 7	- TX Caracter

		.include "m8535def.inc"
		.cseg							;QUE TODO LO QUE SIGUE VA A LA MEMORIA DE CODIGO
		.org $0							;DESDE DIRECCION CERO EMPIEZA
		rjmp INICIO

INICIO: LDI 	R16, 	LOW(RAMEND)		;------------------------
		OUT 	SPL, 	R16				;    INICIALIZAMOS EL 
		LDI 	R16, 	HIGH(RAMEND)	;	 STACK POINTER
		OUT 	SPH, 	R16				;------------------------ 

		LDI		R16, 	$FF
		OUT 	DDRB,	R16

		LDI		R16,	78				;SE CONFIGURA LA FRECUENCIA 
		OUT 	UBRRL, 	R16				;	9600@12MHz	

		LDI 	R16,	0b10000110
		OUT		UCSRC,	R16

		SBI		UCSRB,	TXEN			;SE ENCIENDE EN MODO DE TRANSMICION
		LDI		R16,	$52				;VALOR DE CARACTER 'R'
		OUT 	PORTB,	R16	
									
DATO:	OUT		UDR,	R16				;SE TRANSMITE CARACTER 'R'

LOOP:	SBIS	UCSRA,	UDRE			;SE ESPERA EL FIN DE TRANSMICION DEL CARACTER
		RJMP	LOOP			
DELAY1: LDI 	R22, 	$2F
		RJMP 	DLY1 
DLY1:	DEC 	R20
		BRNE  	DLY1
		DEC 	R21
		BRNE 	DLY1
		DEC 	R22
		BRNE 	DLY1
		RJMP 	INICIO
