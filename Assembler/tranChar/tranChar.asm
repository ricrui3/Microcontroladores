; Author : Ricardo Ruiz Maldonado
; Practica 5: PWM C/Timer2 Up/Down

		.include "m8535def.inc"
		.cseg							;QUE TODO LO QUE SIGUE VA A LA MEMORIA DE CODIGO
		.org $0							;DESDE DIRECCION CERO EMPIEZA
		rjmp INICIO



INICIO: LDI 	R16, 	LOW(RAMEND)		;------------------------
		OUT 	SPL, 	R16				;    INICIALIZAMOS EL 
		LDI 	R16, 	HIGH(RAMEND)	;	 STACK POINTER
		OUT 	SPH, 	R16				;------------------------ 

		LDI		R16,	79				;SE CONFIGURA LA FRECUENCIA 
		OUT 	UBRRL, 	R16				;	9600@12MHz	

		LDI 	R16,	0b10000110
		OUT		UCSRC,	R16

		LDI		R16,	0b00001000
		SBI		UCSRB,	R16				;SE ENCIENDE EN MODO DE TRANSMICION
		LDI		R16,	$41				;VALOR DE CARACTER 'R'
									
DATO:	OUT		UDR,	R16				;SE TRANSMITE CARACTER 'R'

LOOP:	SBIS	UCSRA,	UDRE			;SE ESPERA EL FIN DE TRANSMICION DEL CARACTER
		RJMP	LOOP			

DELAY: 	DEC 	R20
		BRNE 	DELAY
		DEC 	R21
		BRNE 	DELAY
		DEC 	R22
		BRNE 	DELAY
		RJMP	INICIO
