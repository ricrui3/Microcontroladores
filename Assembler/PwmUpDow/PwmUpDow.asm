; Author : Ricardo Ruiz Maldonado
; Practica 5: PWM C/Timer2 Up/Down
		.INCLUDE	"M8535DEF.INC"              
        .CSEG

        .ORG	$0					
      	RJMP	INICIO			
        .ORG	$015				

INICIO:	LDI		R16,	LOW(RAMEND)	 ;------------------------
     	OUT		SPL,	R16			 ;    INICIALIZAMOS EL 
     	LDI		R16,	HIGH(RAMEND) ;	 STACK POINTER
      	OUT		SPH,	R16			 ;------------------------ 
      	LDI		R16, 	$80		
		OUT		DDRD,	R16		;;;;;;;;;;;;;;;;;;;;;;;;;;;;;
		SER		R16	    		;R16 <- $FF
      	OUT		PORTA,	R16	    ;ACTIVA PULL-UP EN PUERTO A
      							;	PARA RECIBIR VALORES DIP
		OUT		DDRB,	R16		;CONFIGURA PUERTO B COMO SALIDA

		LDI		R16,	$62		;SE HABILITA MODO PWM EN TIMER2
		OUT		TCCR2,	R16		;	EN MODO NORMAL

		LDI		R16,	$02		;SE CONFIGURA TIMER CERO CON VALOR 
		OUT		TCCR1B,	R16		;	DE 2 = CLCK/8 (FRECUENCIA)

UP:		IN		R16,	TIFR	;SE LEE TIFR COMPLETO Y SE PASA A UN REGISTRO DE PROPOSITO GENERAL R16
		SBRS	R16,	2		;SE CHECA SI LA BADERA BIT 0 ESTа EN 1
		RJMP	UP				;FALSO
		INC		R17				;VERDADERO
		OUT		PORTB,	R17		;SE ESCRIBE CONTEO EN PUERTO B
		OUT		OCR2,	R17		;ESCRIBO FACTOR DE MODULACIсN PARA PWM
								;OCR2 COMPARADOR
		LDI		R16,	$04		;SE TIENE QUE APAGAR TIFR PARA QUE SE PONGA EN CERO SE BORRA CON 1 = $01
		OUT		TIFR,	R16		;SE BORRA TIFR	
		CPI 	R17, 	$FF
		BREQ	DOWN
		RJMP	UP

DOWN: 	IN		R16,	TIFR	;SE LEE TIFR COMPLETO Y SE PASA A UN REGISTRO DE PROPOSITO GENERAL R16
		SBRS	R16,	2		;SE CHECA SI LA BADERA BIT 0 ESTа EN 1
		RJMP	DOWN			;FALSO
		DEC		R17				;VERDADERO
		OUT		PORTB,	R17		;SE ESCRIBE CONTEO EN PUERTO B
		OUT		OCR2,	R17		;ESCRIBO FACTOR DE MODULACIсN PARA PWM
								;OCR2 COMPARADOR
		LDI		R16,	$04		;SE TIENE QUE APAGAR TIFR PARA QUE SE PONGA EN CERO SE BORRA CON 1 = $01
		OUT		TIFR,	R16		;SE BORRA TIFR	
		CPI		R17, 	$00
		BREQ	UP
		RJMP	DOWN
