; Author : Ricardo Ruiz Maldonado
; Practica 11 	- Eco Cadena con Lectura/Escritura en RAM
    	
    	.INCLUDE"M32DEF.INC"
		.CSEG
		.ORG $000
		RJMP INICIO
		.ORG $015
INICIO:	LDI R16,$5f
		OUT SPL,R16
		LDI R16,$02
		OUT SPH,R16
		LDI R16,$FF
		OUT DDRB,R16 ;HABILITA PUERTO B c/salida
        OUT PORTA,R16;HABILITA EL PULLUP EN EL PUERTO A
		LDI R16,77
		OUT UBRRL,R16  ;cfg Baud Rate a 9600
		LDI R17,$24    ; testigo de fin de cadena
CADENA:	LDI XL,$60
		LDI XH,$00
		LDI R16,0b00010000; HABILITA RECEPCION
		OUT UCSRB, R16
        RCALL DELAY
        CLZ
DATO:   SBIS UCSRA, RXC
		RJMP DATO
		IN  R16, UDR
		OUT PORTB, R16    ;RECIBE CADENA DESDE HIPERTERMINAL
		ST X+,R16
		CPSE R16,R17
		BRNE DATO
		RCALL DELAY
        CLZ
		LDI R16,0b00001000; HABILITA TRANSMISION
		OUT UCSRB, R16
		LDI XL,$60
		LDI XH,$00
SEND:	LD  R16,X+
		OUT UDR, R16
LOOP:	SBIS UCSRA,UDRE
        RJMP LOOP
        CPSE R16,R17
		BRNE SEND
		RJMP CADENA
        RCALL DELAY
		CLZ
		RJMP INICIO
DELAY:  DEC R20
	    BRNE DELAY
		DEC R21
		BRNE DELAY
		RET