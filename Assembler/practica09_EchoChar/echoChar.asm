; Author : Ricardo Ruiz Maldonado
; Practica 9	- Eco Caracter

		.include "m8535def.inc"
		.cseg		;QUE TODO LO QUE SIGUE VA A LA MEMORIA DE CODIGO
		.org $0		;DESDE DIRECCION CERO EMPIEZA
		rjmp INICIO

INICIO:	LDI 	R16, 	LOW(RAMEND)		;------------------------
		OUT 	SPL, 	R16				;    INICIALIZAMOS EL 
		LDI 	R16, 	HIGH(RAMEND)	;	 STACK POINTER
		OUT 	SPH, 	R16				;------------------------

		LDI		R16,	79				;SE CONFIGURA LA FRECUENCIA 9600@12MHz	
		OUT 	UBRRL, 	R16				;

		SBI		UCSRB,	RXEN			;SE ENCIENDE EN MODO DE RECEPCION
					
		LDI		R16,	$FF				;VALOR DE FF PARA MANDAR COMO 
										;	SALIDA TODO EL PUERTO
		OUT		DDRB,	R16				;PUERTO B COMO SALIDA								

DATO:	SBIS	UCSRA,	RXC				;SE ESPERA DATO RECIBIDO
		RJMP	DATO
		IN		R16,	UDR				;LEE DATO RECIBIDO
		OUT		PORTB,	R16				;ESCIRBE DATO EN PUERTO B

		SBI 	UCSRB, TXEN
		OUT		UDR,	R16

LOOP:	SBIS	UCSRA,	UDRE			;SE ESPERA EL FIN DE TRANSMICION DEL CARACTER
		RJMP	LOOP

DELAY1: LDI 	R22, 	$14
		RJMP 	DLY1 
DLY1:	DEC 	R20
		BRNE  	DLY1
		DEC 	R21
		BRNE 	DLY1
		DEC 	R22
		BRNE 	DLY1
		RJMP 	INICIO
